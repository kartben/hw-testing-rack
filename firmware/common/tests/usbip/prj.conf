## CMakeLists.txt
```
# Zephyr's USB/IP service with the rack's patches (zephyr/patches.yml) on
# native_sim: the virtual USB bus, a device on it with a loopback function, a
# serial converter and a mass-storage-like function, that the shell unplugs
# and plugs again.  The client is test_usbip.py.
# SPDX-License-Identifier: Apache-2.0

cmake_minimum_required(VERSION 3.20.0)

find_package(Zephyr REQUIRED HINTS $ENV{ZEPHYR_BASE})
project(usbip_sim)

include(${ZEPHYR_BASE}/samples/subsys/usb/common/common.cmake)

target_sources(app PRIVATE src/main.c src/serial_emu.c src/storage_emu.c)
```

## Kconfig
```
# SPDX-License-Identifier: Apache-2.0

# The virtual bus runs on the system clock (as tests/subsys/usb/host)
config SYS_CLOCK_TICKS_PER_SEC
	default 1000000 if BOARD_NATIVE_SIM

# The device: Zephyr's USB sample helper (VID, PID, strings)
source "samples/subsys/usb/common/Kconfig.sample_usbd"

source "Kconfig.zephyr"
```

## prj.conf
```kconfig
# USB/IP on native_sim (see CMakeLists.txt)
# SPDX-License-Identifier: Apache-2.0

# The service on the virtual host controller, two export contexts
CONFIG_USB_HOST_STACK=y
CONFIG_UHC_DRIVER=y
CONFIG_USBIP=y
CONFIG_USBIP_DEVICES_COUNT=2
CONFIG_USBIP_READ_AHEAD=y
# The bay node's pool, smaller than a mass storage request: those go through
# it in 4 KB transfers, their data in the system heap
CONFIG_USBIP_BUF_POOL_SIZE=49152
CONFIG_USBIP_SEGMENT_SIZE=4096
CONFIG_HEAP_MEM_POOL_SIZE=262144

# The device on the virtual bus: the loopback class (bulk endpoints in
# interface 0, alternate 1), the serial converter (src/serial_emu.c) and the
# mass-storage-like function (src/storage_emu.c)
CONFIG_USB_DEVICE_STACK_NEXT=y
CONFIG_USBD_LOOPBACK_CLASS=y
CONFIG_UDC_BUF_POOL_SIZE=8192
CONFIG_SAMPLE_USBD_PRODUCT="USB/IP test device"

# Networking through the host's own sockets: no TAP, no root
CONFIG_NETWORKING=y
CONFIG_NET_DRIVERS=y
CONFIG_NET_SOCKETS=y
CONFIG_NET_SOCKETS_OFFLOAD=y
CONFIG_NET_NATIVE_OFFLOADED_SOCKETS=y
CONFIG_ETH_NATIVE_TAP=n
CONFIG_NET_IPV4=y
CONFIG_NET_IPV6=n
CONFIG_NET_TCP=y
CONFIG_ZVFS_OPEN_MAX=16

# The shell on stdin: "dut off", "dut on"
CONFIG_SHELL=y
CONFIG_SHELL_BACKEND_SERIAL=y
CONFIG_SHELL_PROMPT_UART="sim:~$ "

CONFIG_LOG=y
CONFIG_ASSERT=y
```

## app.overlay
```dts
/*
 * Zephyr's virtual USB bus: a host controller with a device controller on it
 * (as tests/subsys/usb/host).
 *
 * SPDX-License-Identifier: Apache-2.0
 */

/delete-node/ &zephyr_udc0;

/ {
	zephyr_uhc0: uhc_vrt0 {
		compatible = "zephyr,uhc-virtual";

		zephyr_udc0: udc_vrt0 {
			compatible = "zephyr,udc-virtual";
			num-bidir-endpoints = <8>;
			maximum-speed = "full-speed";
		};
	};
};
```

## src/main.c
```c
/*
 * USB/IP on native_sim: the service (CONFIG_USBIP, with zephyr/patches.yml)
 * starts by itself on the virtual host controller; this puts a device on the
 * virtual bus, a loopback function, a serial converter (serial_emu.c) and a
 * mass-storage-like function (storage_emu.c), and drives them from the shell:
 *
 *   dut off    the device goes (as a board that resets or is unplugged)
 *   dut on     it comes back and enumerates again
 *   ra <mode>  how the service reads ahead from now on: none, stream, ftdi
 *   sessions   the imported devices, as the service tells the application
 *
 * The client is test_usbip.py.
 *
 * SPDX-License-Identifier: Apache-2.0
 */

#include <string.h>

#include <zephyr/kernel.h>
#include <zephyr/net/socket.h>
#include <zephyr/shell/shell.h>
#include <zephyr/sys/printk.h>
#include <zephyr/usb/usbd.h>
#include <zephyr/usb/usbip.h>

#include <sample_usbd.h>

static struct usbd_context *dut;

static int cmd_dut(const struct shell *sh, size_t argc, char **argv)
{
	int ret;

	ARG_UNUSED(argc);

	if (strcmp(argv[1], "on") == 0) {
		ret = usbd_enable(dut);
	} else if (strcmp(argv[1], "off") == 0) {
		ret = usbd_disable(dut);
	} else {
		shell_error(sh, "usage: dut on|off");
		return -EINVAL;
	}

	shell_print(sh, "SIM: dut %s: %d", argv[1], ret);

	return ret;
}

SHELL_CMD_ARG_REGISTER(dut, NULL, "on|off: plug or unplug the device", cmd_dut, 2, 0);

static enum usbip_read_ahead ra_mode;

static enum usbip_read_ahead read_ahead(const struct usb_device_descriptor *desc)
{
	ARG_UNUSED(desc);

	return ra_mode;
}

static int cmd_ra(const struct shell *sh, size_t argc, char **argv)
{
	ARG_UNUSED(argc);

	if (strcmp(argv[1], "none") == 0) {
		ra_mode = USBIP_READ_AHEAD_NONE;
	} else if (strcmp(argv[1], "stream") == 0) {
		ra_mode = USBIP_READ_AHEAD_STREAM;
	} else if (strcmp(argv[1], "ftdi") == 0) {
		ra_mode = USBIP_READ_AHEAD_FTDI;
	} else {
		shell_error(sh, "usage: ra none|stream|ftdi");
		return -EINVAL;
	}

	shell_print(sh, "SIM: ra %s: 0", argv[1]);

	return 0;
}

SHELL_CMD_ARG_REGISTER(ra, NULL, "none|stream|ftdi: read-ahead of the next session", cmd_ra,
		       2, 0);

static int cmd_sessions(const struct shell *sh, size_t argc, char **argv)
{
	struct usbip_session_info info[CONFIG_USBIP_DEVICES_COUNT];
	char addr[NET_INET_ADDRSTRLEN];
	int n;

	ARG_UNUSED(argc);
	ARG_UNUSED(argv);

	n = usbip_get_sessions(info, ARRAY_SIZE(info));
	for (int i = 0; i < n; i++) {
		zsock_inet_ntop(NET_AF_INET, &net_sin(&info[i].peer)->sin_addr, addr, sizeof(addr));
		shell_print(sh, "SIM: session %s from %s since %lld", info[i].busid, addr,
			    info[i].since_ms);
	}

	shell_print(sh, "SIM: sessions: 0");

	return 0;
}

SHELL_CMD_REGISTER(sessions, NULL, "the imported devices", cmd_sessions);

int main(void)
{
	int ret;

	usbip_set_read_ahead_cb(read_ahead);

	dut = sample_usbd_init_device(NULL);
	if (dut == NULL) {
		printk("SIM: no device\n");
		return 0;
	}

	ret = usbd_enable(dut);
	printk("SIM: ready (%d)\n", ret);

	return 0;
}
```

## src/serial_emu.c
```c
/*
 * A USB serial converter on the virtual bus, for the read-ahead tests.  A
 * counter (one byte, +1 each) comes in at a set rate into a 256-byte receive
 * FIFO, as from a UART; the bytes that find it full are dropped.  The FIFO goes
 * out on a bulk IN endpoint as an FTDI converter sends it: two status bytes
 * then up to 62 bytes per packet, a packet as soon as 62 bytes are there, or
 * when the latency timer expires (status bytes alone if there is no data).  In
 * raw mode, packets of plain data, a short one when the timer expires.
 *
 *   emu reset [raw]      idle, FIFO empty, latency 16 ms, FTDI framing or raw
 *   emu rate <bytes/s>   the incoming rate (0 stops it)
 *   emu status <s0>      the modem status byte
 *   emu lsr <bits>       line status bits of the next packet (an error)
 *   emu stats            "SIM: emu made <n> dropped <n> purged <n>"
 *
 * The FTDI vendor requests the read-ahead looks at: reset (0) with wValue 0
 * (reset) or 1 (purge receive) empties the FIFO; set latency timer (9).
 *
 * SPDX-License-Identifier: Apache-2.0
 */

#include <stdlib.h>
#include <string.h>

#include <zephyr/kernel.h>
#include <zephyr/shell/shell.h>
#include <zephyr/sys/byteorder.h>
#include <zephyr/usb/usbd.h>

#define EMU_FIFO_SIZE		256
#define EMU_MPS			64
#define EMU_LSR_IDLE		0x60	/* THRE, TEMT */
#define EMU_REQ_RESET		0x00
#define EMU_REQ_SET_LATENCY	0x09

struct emu_desc {
	struct usb_if_descriptor if0;
	struct usb_ep_descriptor if0_in_ep;
	struct usb_desc_header nil_desc;
};

static struct emu_desc emu_desc = {
	.if0 = {
		.bLength = sizeof(struct usb_if_descriptor),
		.bDescriptorType = USB_DESC_INTERFACE,
		.bInterfaceNumber = 0,
		.bAlternateSetting = 0,
		.bNumEndpoints = 1,
		/* As an FTDI converter: the tests find it by its subclass */
		.bInterfaceClass = USB_BCC_VENDOR,
		.bInterfaceSubClass = 0xFF,
		.bInterfaceProtocol = 0xFF,
		.iInterface = 0,
	},
	.if0_in_ep = {
		.bLength = sizeof(struct usb_ep_descriptor),
		.bDescriptorType = USB_DESC_ENDPOINT,
		.bEndpointAddress = 0x83,
		.bmAttributes = USB_EP_TYPE_BULK,
		.wMaxPacketSize = sys_cpu_to_le16(EMU_MPS),
		.bInterval = 0,
	},
};

static const struct usb_desc_header *const emu_fs_desc[] = {
	(struct usb_desc_header *)&emu_desc.if0,
	(struct usb_desc_header *)&emu_desc.if0_in_ep,
	(struct usb_desc_header *)&emu_desc.nil_desc,
};

static struct {
	struct k_work_delayable work;
	struct k_spinlock lock;
	struct usbd_class_data *c_data;
	bool enabled;
	/* A packet is queued on the endpoint */
	bool busy;
	bool raw;
	uint8_t fifo[EMU_FIFO_SIZE];
	size_t head;
	size_t count;
	/* The next byte of the counter */
	uint8_t next;
	uint32_t rate;
	int64_t rate_start;
	uint64_t rate_made;
	uint64_t made;
	uint64_t dropped;
	uint64_t purged;
	uint8_t latency;
	int64_t last_tx;
	uint8_t s0;
	uint8_t lsr;
} emu;

static void emu_work_handler(struct k_work *work)
{
	const uint8_t ep = emu_desc.if0_in_ep.bEndpointAddress;
	struct net_buf *buf = NULL;
	k_spinlock_key_t key;
	uint64_t target;
	size_t payload;
	int64_t now;
	size_t n;

	ARG_UNUSED(work);

	key = k_spin_lock(&emu.lock);
	if (!emu.enabled) {
		k_spin_unlock(&emu.lock, key);
		return;
	}

	now = k_uptime_get();
	target = (uint64_t)emu.rate * (uint64_t)(now - emu.rate_start) / 1000U;
	while (emu.rate_made < target) {
		if (emu.count < EMU_FIFO_SIZE) {
			emu.fifo[(emu.head + emu.count) % EMU_FIFO_SIZE] = emu.next;
			emu.count++;
		} else {
			emu.dropped++;
		}

		emu.next++;
		emu.rate_made++;
		emu.made++;
	}

	payload = emu.raw ? EMU_MPS : EMU_MPS - 2;
	if (!emu.busy && (emu.count >= payload ||
			  (now - emu.last_tx >= emu.latency && (!emu.raw || emu.count > 0)))) {
		buf = usbd_ep_buf_alloc(emu.c_data, ep, EMU_MPS);
	}

	if (buf != NULL) {
		if (!emu.raw) {
			net_buf_add_u8(buf, emu.s0);
			net_buf_add_u8(buf, EMU_LSR_IDLE | emu.lsr);
			emu.lsr = 0;
		}

		for (n = MIN(emu.count, payload); n > 0; n--) {
			net_buf_add_u8(buf, emu.fifo[emu.head]);
			emu.head = (emu.head + 1) % EMU_FIFO_SIZE;
			emu.count--;
		}

		emu.busy = true;
	}

	k_spin_unlock(&emu.lock, key);

	if (buf != NULL && usbd_ep_enqueue(emu.c_data, buf) != 0) {
		net_buf_unref(buf);
		key = k_spin_lock(&emu.lock);
		emu.busy = false;
		k_spin_unlock(&emu.lock, key);
	}

	k_work_reschedule(&emu.work, K_MSEC(1));
}

static int emu_request(struct usbd_class_data *const c_data, struct net_buf *const buf,
		       const int err)
{
	k_spinlock_key_t key;

	ARG_UNUSED(c_data);
	ARG_UNUSED(err);

	net_buf_unref(buf);

	key = k_spin_lock(&emu.lock);
	emu.busy = false;
	/* The timer starts again once a packet is out */
	emu.last_tx = k_uptime_get();
	k_spin_unlock(&emu.lock, key);

	/* A full packet goes out at once */
	k_work_reschedule(&emu.work, K_NO_WAIT);

	return 0;
}

static int emu_control_to_dev(struct usbd_class_data *const c_data,
			      const struct usb_setup_packet *const setup,
			      const struct net_buf *const buf)
{
	const uint16_t value = sys_le16_to_cpu(setup->wValue);
	k_spinlock_key_t key;
	int ret = 0;

	ARG_UNUSED(c_data);
	ARG_UNUSED(buf);

	if (setup->RequestType.recipient != USB_REQTYPE_RECIPIENT_DEVICE || setup->wLength != 0) {
		return -ENOTSUP;
	}

	key = k_spin_lock(&emu.lock);
	if (setup->bRequest == EMU_REQ_RESET) {
		if (value <= 1) {
			emu.purged += emu.count;
			emu.count = 0;
		}
	} else if (setup->bRequest == EMU_REQ_SET_LATENCY) {
		emu.latency = MAX(value & 0xFF, 1);
	} else {
		ret = -ENOTSUP;
	}
	k_spin_unlock(&emu.lock, key);

	return ret;
}

static const void *emu_get_desc(struct usbd_class_data *const c_data, const enum usbd_speed speed)
{
	ARG_UNUSED(c_data);
	ARG_UNUSED(speed);

	return emu_fs_desc;
}

static void emu_enable(struct usbd_class_data *const c_data)
{
	k_spinlock_key_t key = k_spin_lock(&emu.lock);

	emu.c_data = c_data;
	emu.enabled = true;
	emu.busy = false;
	emu.last_tx = k_uptime_get();
	k_spin_unlock(&emu.lock, key);

	k_work_reschedule(&emu.work, K_MSEC(1));
}

static void emu_disable(struct usbd_class_data *const c_data)
{
	k_spinlock_key_t key = k_spin_lock(&emu.lock);

	ARG_UNUSED(c_data);

	emu.enabled = false;
	k_spin_unlock(&emu.lock, key);
}

static void emu_reset(const bool raw)
{
	k_spinlock_key_t key = k_spin_lock(&emu.lock);
	bool busy = emu.busy;

	emu.rate = 0;
	emu.rate_start = k_uptime_get();
	emu.rate_made = 0;
	emu.made = 0;
	emu.dropped = 0;
	emu.purged = 0;
	emu.count = 0;
	emu.raw = raw;
	emu.latency = 16;
	emu.s0 = 0x01;
	emu.lsr = 0;
	k_spin_unlock(&emu.lock, key);

	/* The packet waiting for the host goes too */
	if (busy) {
		(void)usbd_ep_dequeue(usbd_class_get_ctx(emu.c_data),
				      emu_desc.if0_in_ep.bEndpointAddress);
	}
}

static int emu_init(struct usbd_class_data *const c_data)
{
	ARG_UNUSED(c_data);

	k_work_init_delayable(&emu.work, emu_work_handler);
	emu_reset(false);

	return 0;
}

static const struct usbd_class_api emu_api = {
	.control_to_dev = emu_control_to_dev,
	.request = emu_request,
	.get_desc = emu_get_desc,
	.enable = emu_enable,
	.disable = emu_disable,
	.init = emu_init,
};

static const struct usbd_cctx_vendor_req emu_vregs =
	USBD_VENDOR_REQ(EMU_REQ_RESET, EMU_REQ_SET_LATENCY);

/* Named to come after the loopback class: it keeps interface 0 and ep 0x81 */
USBD_DEFINE_CLASS(serial_emu, &emu_api, NULL, &emu_vregs);

static int emu_done(const struct shell *sh, size_t argc, char **argv, int ret)
{
	shell_fprintf(sh, SHELL_NORMAL, "SIM: emu");
	for (size_t i = 0; i < argc; i++) {
		shell_fprintf(sh, SHELL_NORMAL, " %s", argv[i]);
	}
	shell_fprintf(sh, SHELL_NORMAL, ": %d\n", ret);

	return ret;
}

static int cmd_emu_reset(const struct shell *sh, size_t argc, char **argv)
{
	emu_reset(argc > 1 && strcmp(argv[1], "raw") == 0);

	return emu_done(sh, argc, argv, 0);
}

static int cmd_emu_rate(const struct shell *sh, size_t argc, char **argv)
{
	k_spinlock_key_t key = k_spin_lock(&emu.lock);

	emu.rate = strtoul(argv[1], NULL, 0);
	emu.rate_start = k_uptime_get();
	emu.rate_made = 0;
	k_spin_unlock(&emu.lock, key);

	return emu_done(sh, argc, argv, 0);
}

static int cmd_emu_status(const struct shell *sh, size_t argc, char **argv)
{
	emu.s0 = strtoul(argv[1], NULL, 0);

	return emu_done(sh, argc, argv, 0);
}

static int cmd_emu_lsr(const struct shell *sh, size_t argc, char **argv)
{
	emu.lsr = strtoul(argv[1], NULL, 0);

	return emu_done(sh, argc, argv, 0);
}

static int cmd_emu_stats(const struct shell *sh, size_t argc, char **argv)
{
	k_spinlock_key_t key = k_spin_lock(&emu.lock);
	uint64_t made = emu.made;
	uint64_t dropped = emu.dropped;
	uint64_t purged = emu.purged;

	k_spin_unlock(&emu.lock, key);

	shell_print(sh, "SIM: emu made %llu dropped %llu purged %llu", made, dropped, purged);

	return emu_done(sh, argc, argv, 0);
}

SHELL_STATIC_SUBCMD_SET_CREATE(emu_cmds,
	SHELL_CMD_ARG(reset, NULL, "[raw]: idle, FIFO empty", cmd_emu_reset, 1, 1),
	SHELL_CMD_ARG(rate, NULL, "<bytes/s>: incoming rate", cmd_emu_rate, 2, 0),
	SHELL_CMD_ARG(status, NULL, "<s0>: modem status", cmd_emu_status, 2, 0),
	SHELL_CMD_ARG(lsr, NULL, "<bits>: line status of the next packet", cmd_emu_lsr, 2, 0),
	SHELL_CMD_ARG(stats, NULL, "bytes made, dropped, purged", cmd_emu_stats, 1, 0),
	SHELL_SUBCMD_SET_END
);

SHELL_CMD_REGISTER(emu, &emu_cmds, "serial converter on the virtual bus", NULL);
```

## src/storage_emu.c
```c
/*
 * A mass-storage-like function on the virtual bus, for the large request
 * tests: a bulk IN endpoint that sends a stream of a set length, and a bulk
 * OUT endpoint that checks what it receives.  Both carry the same pattern,
 * byte i being i ^ (i >> 8) ^ (i >> 16), so that a segment lost or sent twice
 * shows.
 *
 *   msd reset              nothing to send, counters at 0, full speed
 *   msd in <len> [zlp]     send a stream of len bytes (a ZLP after it)
 *   msd rate <packets/ms>  at most that many 64-byte packets per ms each way
 *   msd stall <offset>     halt the IN endpoint once offset bytes are sent
 *   msd stats              "SIM: msd in <sent> out <received> bad <bytes>"
 *
 * SPDX-License-Identifier: Apache-2.0
 */

#include <stdlib.h>
#include <string.h>

#include <zephyr/drivers/usb/udc.h>
#include <zephyr/kernel.h>
#include <zephyr/shell/shell.h>
#include <zephyr/sys/byteorder.h>
#include <zephyr/usb/usbd.h>

#define MSD_MPS		64
#define MSD_BUF_SIZE	512

struct msd_desc {
	struct usb_if_descriptor if0;
	struct usb_ep_descriptor if0_in_ep;
	struct usb_ep_descriptor if0_out_ep;
	struct usb_desc_header nil_desc;
};

static struct msd_desc msd_desc = {
	.if0 = {
		.bLength = sizeof(struct usb_if_descriptor),
		.bDescriptorType = USB_DESC_INTERFACE,
		.bInterfaceNumber = 0,
		.bAlternateSetting = 0,
		.bNumEndpoints = 2,
		/* Mass storage, SCSI, bulk-only: the tests find it by its class */
		.bInterfaceClass = 0x08,
		.bInterfaceSubClass = 0x06,
		.bInterfaceProtocol = 0x50,
		.iInterface = 0,
	},
	.if0_in_ep = {
		.bLength = sizeof(struct usb_ep_descriptor),
		.bDescriptorType = USB_DESC_ENDPOINT,
		.bEndpointAddress = 0x84,
		.bmAttributes = USB_EP_TYPE_BULK,
		.wMaxPacketSize = sys_cpu_to_le16(MSD_MPS),
		.bInterval = 0,
	},
	.if0_out_ep = {
		.bLength = sizeof(struct usb_ep_descriptor),
		.bDescriptorType = USB_DESC_ENDPOINT,
		.bEndpointAddress = 0x04,
		.bmAttributes = USB_EP_TYPE_BULK,
		.wMaxPacketSize = sys_cpu_to_le16(MSD_MPS),
		.bInterval = 0,
	},
};

static const struct usb_desc_header *const msd_fs_desc[] = {
	(struct usb_desc_header *)&msd_desc.if0,
	(struct usb_desc_header *)&msd_desc.if0_in_ep,
	(struct usb_desc_header *)&msd_desc.if0_out_ep,
	(struct usb_desc_header *)&msd_desc.nil_desc,
};

static struct {
	struct k_work_delayable work;
	struct k_spinlock lock;
	struct usbd_class_data *c_data;
	bool enabled;
	bool in_busy;
	bool out_busy;
	/* The IN stream: its length, bytes queued, a ZLP after it */
	uint32_t in_len;
	uint32_t in_sent;
	bool in_zlp;
	uint32_t stall_at;
	uint32_t out_recv;
	uint32_t out_bad;
	/* Packets per ms each way, 0 for no limit, and what is left of it */
	uint32_t rate;
	uint32_t in_budget;
	uint32_t out_budget;
	int64_t refilled;
} msd;

static uint8_t msd_pattern(const uint32_t i)
{
	return i ^ (i >> 8) ^ (i >> 16);
}

static uint8_t msd_ep_in(void)
{
	return msd_desc.if0_in_ep.bEndpointAddress;
}

static uint8_t msd_ep_out(void)
{
	return msd_desc.if0_out_ep.bEndpointAddress;
}

/* Bytes the rate lets through now, in whole packets */
static size_t msd_allowed(uint32_t *const budget, const size_t len)
{
	if (msd.rate == 0) {
		return len;
	}

	return MIN(len, *budget * MSD_MPS);
}

static void msd_work_handler(struct k_work *work)
{
	struct net_buf *in = NULL;
	struct net_buf *out = NULL;
	bool halt = false;
	k_spinlock_key_t key;
	size_t n;

	ARG_UNUSED(work);

	key = k_spin_lock(&msd.lock);
	if (!msd.enabled) {
		k_spin_unlock(&msd.lock, key);
		return;
	}

	if (msd.rate != 0 && k_uptime_get() > msd.refilled) {
		msd.refilled = k_uptime_get();
		msd.in_budget = MIN(msd.in_budget + msd.rate, 2 * msd.rate);
		msd.out_budget = MIN(msd.out_budget + msd.rate, 2 * msd.rate);
	}

	if (!msd.in_busy && msd.stall_at != 0 && msd.in_sent >= msd.stall_at) {
		msd.stall_at = 0;
		msd.in_len = msd.in_sent;
		halt = true;
	} else if (!msd.in_busy && msd.in_sent < msd.in_len) {
		n = MIN(msd.in_len - msd.in_sent, MSD_BUF_SIZE);
		if (msd.stall_at > msd.in_sent) {
			n = MIN(n, msd.stall_at - msd.in_sent);
		}

		n = msd_allowed(&msd.in_budget, n);
		if (n != 0) {
			in = usbd_ep_buf_alloc(msd.c_data, msd_ep_in(), n);
		}

		if (in != NULL) {
			for (size_t i = 0; i < n; i++) {
				net_buf_add_u8(in, msd_pattern(msd.in_sent + i));
			}

			msd.in_sent += n;
			msd.in_budget -= DIV_ROUND_UP(n, MSD_MPS) * (msd.rate != 0);
			msd.in_busy = true;
			if (msd.in_zlp && msd.in_sent == msd.in_len && n % MSD_MPS == 0) {
				udc_ep_buf_set_zlp(in);
			}
		}
	}

	if (!msd.out_busy) {
		n = msd_allowed(&msd.out_budget, MSD_BUF_SIZE);
		if (n != 0) {
			out = usbd_ep_buf_alloc(msd.c_data, msd_ep_out(), n);
		}

		if (out != NULL) {
			msd.out_budget -= DIV_ROUND_UP(n, MSD_MPS) * (msd.rate != 0);
			msd.out_busy = true;
		}
	}

	k_spin_unlock(&msd.lock, key);

	if (halt) {
		(void)usbd_ep_set_halt(usbd_class_get_ctx(msd.c_data), msd_ep_in());
	}

	if (in != NULL && usbd_ep_enqueue(msd.c_data, in) != 0) {
		net_buf_unref(in);
		msd.in_busy = false;
	}

	if (out != NULL && usbd_ep_enqueue(msd.c_data, out) != 0) {
		net_buf_unref(out);
		msd.out_busy = false;
	}

	k_work_reschedule(&msd.work, K_MSEC(1));
}

static int msd_request(struct usbd_class_data *const c_data, struct net_buf *const buf,
		       const int err)
{
	struct udc_buf_info *const bi = udc_get_buf_info(buf);
	k_spinlock_key_t key = k_spin_lock(&msd.lock);

	ARG_UNUSED(c_data);

	if (bi->ep == msd_ep_in()) {
		msd.in_busy = false;
	} else {
		if (err == 0) {
			for (size_t i = 0; i < buf->len; i++) {
				msd.out_bad += buf->data[i] != msd_pattern(msd.out_recv + i);
			}

			msd.out_recv += buf->len;
		}

		msd.out_busy = false;
	}

	k_spin_unlock(&msd.lock, key);
	net_buf_unref(buf);

	k_work_reschedule(&msd.work, K_NO_WAIT);

	return 0;
}

static const void *msd_get_desc(struct usbd_class_data *const c_data, const enum usbd_speed speed)
{
	ARG_UNUSED(c_data);
	ARG_UNUSED(speed);

	return msd_fs_desc;
}

static void msd_enable(struct usbd_class_data *const c_data)
{
	k_spinlock_key_t key = k_spin_lock(&msd.lock);

	msd.c_data = c_data;
	msd.enabled = true;
	msd.in_busy = false;
	msd.out_busy = false;
	k_spin_unlock(&msd.lock, key);

	k_work_reschedule(&msd.work, K_MSEC(1));
}

static void msd_disable(struct usbd_class_data *const c_data)
{
	k_spinlock_key_t key = k_spin_lock(&msd.lock);

	ARG_UNUSED(c_data);

	msd.enabled = false;
	k_spin_unlock(&msd.lock, key);
}

static void msd_reset(void)
{
	k_spinlock_key_t key = k_spin_lock(&msd.lock);
	const bool enabled = msd.enabled;

	msd.in_len = 0;
	msd.in_sent = 0;
	msd.in_zlp = false;
	msd.stall_at = 0;
	msd.out_recv = 0;
	msd.out_bad = 0;
	msd.rate = 0;
	k_spin_unlock(&msd.lock, key);

	/* What waits for the host goes too: the OUT buffer comes back */
	if (enabled) {
		struct usbd_context *const ctx = usbd_class_get_ctx(msd.c_data);

		(void)usbd_ep_dequeue(ctx, msd_ep_in());
		(void)usbd_ep_dequeue(ctx, msd_ep_out());
		(void)usbd_ep_clear_halt(ctx, msd_ep_in());
	}
}

static int msd_init(struct usbd_class_data *const c_data)
{
	ARG_UNUSED(c_data);

	k_work_init_delayable(&msd.work, msd_work_handler);

	return 0;
}

static const struct usbd_class_api msd_api = {
	.request = msd_request,
	.get_desc = msd_get_desc,
	.enable = msd_enable,
	.disable = msd_disable,
	.init = msd_init,
};

/* Named to come after the loopback and serial classes: its interface is the last */
USBD_DEFINE_CLASS(storage_emu, &msd_api, NULL, NULL);

static int msd_done(const struct shell *sh, size_t argc, char **argv, int ret)
{
	shell_fprintf(sh, SHELL_NORMAL, "SIM: msd");
	for (size_t i = 0; i < argc; i++) {
		shell_fprintf(sh, SHELL_NORMAL, " %s", argv[i]);
	}
	shell_fprintf(sh, SHELL_NORMAL, ": %d\n", ret);

	return ret;
}

static int cmd_msd_reset(const struct shell *sh, size_t argc, char **argv)
{
	msd_reset();

	return msd_done(sh, argc, argv, 0);
}

static int cmd_msd_in(const struct shell *sh, size_t argc, char **argv)
{
	k_spinlock_key_t key = k_spin_lock(&msd.lock);

	msd.in_len = strtoul(argv[1], NULL, 0);
	msd.in_sent = 0;
	msd.in_zlp = argc > 2 && strcmp(argv[2], "zlp") == 0;
	k_spin_unlock(&msd.lock, key);

	return msd_done(sh, argc, argv, 0);
}

static int cmd_msd_rate(const struct shell *sh, size_t argc, char **argv)
{
	msd.rate = strtoul(argv[1], NULL, 0);

	return msd_done(sh, argc, argv, 0);
}

static int cmd_msd_stall(const struct shell *sh, size_t argc, char **argv)
{
	msd.stall_at = strtoul(argv[1], NULL, 0);

	return msd_done(sh, argc, argv, 0);
}

static int cmd_msd_stats(const struct shell *sh, size_t argc, char **argv)
{
	k_spinlock_key_t key = k_spin_lock(&msd.lock);
	const uint32_t sent = msd.in_sent;
	const uint32_t recv = msd.out_recv;
	const uint32_t bad = msd.out_bad;

	k_spin_unlock(&msd.lock, key);

	shell_print(sh, "SIM: msd in %u out %u bad %u", sent, recv, bad);

	return msd_done(sh, argc, argv, 0);
}

SHELL_STATIC_SUBCMD_SET_CREATE(msd_cmds,
	SHELL_CMD_ARG(reset, NULL, "nothing to send, counters at 0", cmd_msd_reset, 1, 0),
	SHELL_CMD_ARG(in, NULL, "<len> [zlp]: an IN stream", cmd_msd_in, 2, 1),
	SHELL_CMD_ARG(rate, NULL, "<packets/ms>: 0 for no limit", cmd_msd_rate, 2, 0),
	SHELL_CMD_ARG(stall, NULL, "<offset>: halt IN there", cmd_msd_stall, 2, 0),
	SHELL_CMD_ARG(stats, NULL, "bytes sent, received, bad", cmd_msd_stats, 1, 0),
	SHELL_SUBCMD_SET_END
);

SHELL_CMD_REGISTER(msd, &msd_cmds, "mass-storage-like function on the virtual bus", NULL);
```
