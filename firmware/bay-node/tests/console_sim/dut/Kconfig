## firmware/dts/bindings/hwtr,power-hub.yaml
```yaml
# SPDX-License-Identifier: Apache-2.0

description: |
  The hw-testing-rack power hub (rack controller): what its firmware needs
  to know besides the rows (hwtr,rack-rows).

    power_hub: power-hub {
        compatible = "hwtr,power-hub";
        i2c-pullup-gpios = <&gpio1 10 GPIO_ACTIVE_HIGH>;
        pd = <&pd_sink>;
        vbus-sense = <&vbus_sense>;
        can = <&twai>;
    };

compatible: "hwtr,power-hub"

properties:
  i2c-pullup-gpios:
    type: phandle-array
    description: |
      Powers the PD sink's I2C pull-ups.  The firmware turns it on once VBUS
      is up (the sink runs from VBUS), so that a controller powered from its
      console USB port never back-feeds the unpowered sink.

  pd:
    type: phandle
    required: true
    description: The USB PD sink, as a regulator (the contract), a wch,ch224a.

  vbus-sense:
    type: phandle
    description: Voltage divider on VBUS (ADC), read before the sink answers.

  can:
    type: phandle
    required: true
    description: The CAN controller of the rack bus.
```

## firmware/dts/bindings/hwtr,rack-bus.yaml
```yaml
# SPDX-License-Identifier: Apache-2.0

description: |
  Rack bus of a hw-testing-rack bay node (docs/can.md): the row cable carries
  the rack's CAN bus and the POS addressing token.

    POS is an active-high 3.3 V token.  From reset the node holds POS_OUT low.
    The rack controller raises POS on a row; the node that sees POS_IN high
    and has no address yet answers on CAN with its MAC, takes (row, position)
    from the controller, then raises POS_OUT so that the next node answers.

  Example:

    rack_bus: rack-bus {
        compatible = "hwtr,rack-bus";
        pos-in-gpios = <&gpio0 16 GPIO_ACTIVE_HIGH>;
        pos-out-gpios = <&gpio1 3 GPIO_ACTIVE_HIGH>;
        can = <&twai>;
    };

compatible: "hwtr,rack-bus"

properties:
  pos-in-gpios:
    type: phandle-array
    required: true
    description: |
      POS_IN: the token from the previous node (or the hub), through 10k and
      a clamp, with a 100k pull-down on the board.

  pos-out-gpios:
    type: phandle-array
    required: true
    description: |
      POS_OUT: the token to the next node, through 10k and a clamp.  Hold it
      low until this node has an address.

  can:
    type: phandle
    required: true
    description: The CAN controller on the row cable's CAN pair.
```

## firmware/dts/bindings/hwtr,rack-rows.yaml
```yaml
# SPDX-License-Identifier: Apache-2.0

description: |
  The power hub's row outputs (docs/power.md, docs/can.md): one child per
  row, A = reg 0.  Each row has an eFuse with an enable, an open-drain fault
  flag and a current monitor, and drives the row's POS addressing token.

    rack_rows: rack-rows {
        compatible = "hwtr,rack-rows";
        #address-cells = <1>;
        #size-cells = <0>;

        row_a: row@0 {
            reg = <0>;
            enable-gpios = <&gpio0 14 GPIO_ACTIVE_HIGH>;
            fault-gpios = <&gpio0 18 GPIO_ACTIVE_LOW>;
            pos-gpios = <&gpio0 10 GPIO_ACTIVE_HIGH>;
            current-sense = <&imon_a>;
        };
    };

compatible: "hwtr,rack-rows"

properties:
  "#address-cells":
    type: int
    const: 1
    required: true

  "#size-cells":
    type: int
    const: 0
    required: true

child-binding:
  description: "A row: its eFuse and its POS token."

  properties:
    reg:
      type: int
      required: true
      description: Row index, 0 = A.

    enable-gpios:
      type: phandle-array
      required: true
      description: |
        The eFuse's enable (SHDN).  The board pulls it to "off": a row stays
        off until the firmware turns it on.  The firmware holds the level
        across its own resets.

    fault-gpios:
      type: phandle-array
      required: true
      description: The eFuse's fault flag (current limit, over-temperature).

    pos-gpios:
      type: phandle-array
      required: true
      description: The row's POS token, raised to enumerate its nodes.

    current-sense:
      type: phandle
      description: Sensor on the eFuse's current monitor (current-sense-amplifier).
```

## firmware/dts/bindings/hwtr,usb-mux.yaml
```yaml
# SPDX-License-Identifier: Apache-2.0

description: |
  USB data-path selection on a hw-testing-rack bay node (two FSUSB42
  switches and an OR gate):

    MUX_SEL = PC_DET OR MUX_FORCE_PC
      0: DUT D+/D- <-> ESP32-S3 USB OTG (USB/IP mode)
      1: DUT D+/D- <-> front PC port   (classic mode)
    SVC = 1: front PC port <-> ESP32-S3 internal PHY (USB-Serial-JTAG),
             DUT data disconnected.

  Example:

    usb_mux: usb-mux {
        compatible = "hwtr,usb-mux";
        force-pc-gpios = <&gpio0 10 GPIO_ACTIVE_HIGH>;
        pc-detect-gpios = <&gpio0 4 GPIO_ACTIVE_HIGH>;
        service-gpios = <&gpio0 5 GPIO_ACTIVE_HIGH>;
    };

compatible: "hwtr,usb-mux"

properties:
  force-pc-gpios:
    type: phandle-array
    required: true
    description: |
      MUX_FORCE_PC.  Active = route the DUT to the front PC port even when
      no laptop is detected.  Pulled down on the board.

  pc-detect-gpios:
    type: phandle-array
    required: true
    description: |
      PC_DET: front port VBUS through a 10k/20k divider.  Active = a laptop
      is plugged into the front port (it takes the DUT over in hardware).

  service-gpios:
    type: phandle-array
    required: true
    description: |
      SVC: the SERVICE slide switch.  Active = the front port is routed to
      the ESP32-S3 itself and the DUT data lines are disconnected.
```

## firmware/dts/bindings/wch,ch224a.yaml
```yaml
# SPDX-License-Identifier: Apache-2.0

description: |
  WCH CH224A USB PD 3.2 sink controller (I2C, in the one-resistor mode), as
  a regulator: the USB PD contract.  set_voltage asks for 5, 9, 12, 15, 20
  or 28 V (list_voltage), or a PPS / AVS voltage in a range the charger
  offers; get_voltage is the voltage asked for while the chip reports PD
  (5 V otherwise); the current limit is the current the charger grants.
  Callbacks follow PG: REGULATOR_VOLTAGE_DETECTED once a contract is in
  place, REGULATOR_VOLTAGE_REMOVED when it is lost.  No enable/disable:
  the chip has no switch.

    pd_sink: ch224a@22 {
        compatible = "wch,ch224a";
        reg = <0x22>;
        pg-gpios = <&gpio1 7 GPIO_ACTIVE_LOW>;
        startup-microvolt = <9000000>;
        regulator-min-microvolt = <5000000>;
        regulator-max-microvolt = <28000000>;
    };

  The chip runs from VBUS: with zephyr,deferred-init, the application
  initializes it once VBUS is present.

compatible: "wch,ch224a"

include:
  - i2c-device.yaml
  - name: regulator.yaml
    property-allowlist:
      - regulator-min-microvolt
      - regulator-max-microvolt

properties:
  pg-gpios:
    type: phandle-array
    description: |
      PG, open drain, low once a contract is in place: GPIO_ACTIVE_LOW.

  startup-microvolt:
    type: int
    required: true
    description: |
      What the CFG1 resistor asks for at plug-in (6.8k 9 V, 24k 12 V, 56k
      15 V, 120k 20 V, 210k 28 V): the voltage asked for until the first
      set_voltage, and again once the chip has been off.
```

## firmware/power-hub/tests/budget/testcase.yaml
```yaml
common:
  tags: hwtr
  integration_platforms:
    - native_sim/native/64
tests:
  hwtr.hub.budget:
    platform_allow:
      - native_sim
      - native_sim/native/64
```
