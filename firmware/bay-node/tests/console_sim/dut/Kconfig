## firmware/bay-node/tests/console_sim/dut/Kconfig
```kconfig
# SPDX-License-Identifier: Apache-2.0
# The options of samples/subsys/shell/shell_module/Kconfig

mainmenu "Console simulation: fake DUT"

config SHELL_FOREGROUND_CMDS
	bool "Shell foreground commands example"
	default y

config SHELL_DYNAMIC_CMDS
	bool "Shell dynamic commands example"
	default y

source "Kconfig.zephyr"
```

## firmware/bay-node/tests/ports/testcase.yaml
```yaml
common:
  tags: hwtr
  integration_platforms:
    - native_sim/native/64
tests:
  hwtr.bay.ports:
    platform_allow:
      - native_sim
      - native_sim/native/64
```

## firmware/boards/hwtr/bay_node/Kconfig.bay_node
```kconfig
# SPDX-License-Identifier: Apache-2.0

config BOARD_BAY_NODE
	select SOC_ESP32S3
	select SOC_ESP32S3_PROCPU if BOARD_BAY_NODE_ESP32S3_PROCPU
	select SOC_ESP32S3_APPCPU if BOARD_BAY_NODE_ESP32S3_APPCPU
```

## firmware/boards/hwtr/bay_node/board.yml
```yaml
board:
  name: bay_node
  full_name: hw-testing-rack bay node
  socs:
  - name: esp32s3
```

## firmware/boards/hwtr/power_hub/board.yml
```yaml
board:
  name: power_hub
  full_name: hw-testing-rack power hub
  socs:
  - name: esp32s3
```

## firmware/common/Kconfig
```kconfig
# hw-testing-rack: drivers and libraries shared by the bay node and the power hub
# SPDX-License-Identifier: Apache-2.0

menu "hw-testing-rack"

config REGULATOR_CH224A
	bool "WCH CH224A USB PD contract as a regulator"
	default y
	depends on DT_HAS_WCH_CH224A_ENABLED
	depends on REGULATOR
	select I2C
	help
	  The voltage request, the protocol status, PG and the charger's
	  offers of a CH224A sink (I2C, one-resistor mode).

config REGULATOR_CH224A_INIT_PRIORITY
	int "CH224A regulator init priority"
	default 86
	depends on REGULATOR_CH224A

config HWTR_RACK_PROTO
	bool "Rack bus protocol (docs/rack-protocol.md)"
	help
	  Frame encoding and decoding, shared by the hub and the nodes.

config HWTR_RACK_HUB
	bool "Rack bus: the hub's side (enumeration, node table)"
	select HWTR_RACK_PROTO

config HWTR_RACK_NODE
	bool "Rack bus: a node's side (POS token, address, heartbeat)"
	select HWTR_RACK_PROTO

config HWTR_NET
	bool "Wi-Fi station, hostname <prefix>-<id> and reconnection"
	depends on WIFI && WIFI_CREDENTIALS && NET_HOSTNAME_ENABLE

config HWTR_NET_TX_POWER_DBM
	int "Wi-Fi TX power ceiling (dBm)"
	depends on HWTR_NET
	range 2 20
	default 11
	help
	  Applied before every connection; the radio may round it down to one
	  of its steps.  With the AP 1-3 m away, 11 dBm still leaves 30 dB of
	  margin, and the DUTs' own radios a few cm from the antenna hear much
	  less of it than at the radio's full 20 dBm.  The shell's
	  "radio <dBm>" changes it at run time and saves it; "radio" shows the
	  power the radio really uses.

# Mains powered: the station never sleeps.  In modem sleep the AP holds each
# frame for the station until the next DTIM beacon: the bench XIAO answered a
# wired ping in 174 ms on average (350 ms at worst) against 16 ms awake, and
# every USB/IP request waits as long.
choice ESP32_WIFI_STA_POWER_SAVE_MODE
	default ESP32_WIFI_STA_POWER_SAVE_NONE if HWTR_NET
endchoice

config HWTR_DNSSD
	bool "DNS-SD: the services that listen, under the hostname"
	depends on MDNS_RESPONDER_DNS_SD
	help
	  The application describes its services and a TXT record;
	  hwtr_dnssd keeps the mDNS responder's DNS-SD records in step with
	  them (hwtr/dnssd.h).

config HWTR_DNSSD_REFRESH_MS
	int "How often the advertised services are checked (ms)"
	depends on HWTR_DNSSD
	default 2000

config HWTR_ACL
	bool "Access rules, lease, SHA-256 and HMAC (plain C)"

config HWTR_ADMIN
	bool "Admin key: claim by a button press, signed requests"
	select HWTR_ACL
	help
	  The device's admin key, its first claim confirmed by physical
	  presence (a button press or the local shell), and the check of
	  admin requests signed with it (X-Bay-Auth: nonce and HMAC-SHA256).

config HWTR_ADMIN_CLAIM_S
	int "Time to press the button after a claim request (s)"
	default 60
	depends on HWTR_ADMIN

config HWTR_JPEG
	bool "Where a JPEG ends, in a stream that arrives in pieces (plain C)"

config HWTR_IMG
	bool "MCUboot image header and TLVs, read as they stream in (plain C)"

config HWTR_UPDATE
	bool "Firmware updates over the network"
	default y
	depends on BOOTLOADER_MCUBOOT && HWTR_ADMIN && FLASH_MAP && SETTINGS
	depends on $(dt_nodelabel_enabled,slot1_partition)
	select HWTR_IMG
	select STREAM_FLASH
	select IMG_MANAGER # its choice defaults to MCUboot
	select IMG_ERASE_PROGRESSIVELY
	select REBOOT
	imply WATCHDOG
	help
	  On when the application is built with MCUboot (sysbuild): an admin
	  request opens an update, the signed image streams into slot 1, the
	  device test-boots it, and the new firmware confirms itself once
	  what worked before the update works again (Wi-Fi, rack bus);
	  otherwise MCUboot puts the previous one back.  The HTTP endpoints
	  are firmware/common/web/update_http.c (hwtr_web_update()).

if HWTR_UPDATE

config HWTR_UPDATE_ID
	string "Image id: <application>/<board>"
	help
	  What the image id TLV of an update must say.  Set, with the
	  imgtool argument that writes it into the signed image, by
	  firmware/common/sysbuild.cmake.

config HWTR_UPDATE_TRIAL_S
	int "Time a new firmware has to confirm itself (s)"
	default 180
	help
	  After a test boot, the new firmware must get back what worked
	  before the update (Wi-Fi, the rack bus) within this time, for 5 s
	  in a row; otherwise it reboots unconfirmed and MCUboot puts the
	  previous firmware back.  The watchdog (watchdog0, 30 s) runs during
	  the trial, for a firmware that hangs.

config HWTR_UPDATE_TEST_KEY
	bool "Signed with MCUboot's public test key"
	help
	  Set by firmware/common/sysbuild.cmake when no signing key was
	  given (HWTR_SIGNING_KEY): anyone can sign an image this device's
	  MCUboot accepts.  The page says so.

endif # HWTR_UPDATE

module = HWTR_RACK
module-str = rack bus
source "subsys/logging/Kconfig.template.log_config"

endmenu
```

## firmware/common/tests/ch446q/testcase.yaml
```yaml
common:
  tags: hwtr
  integration_platforms:
    - native_sim/native/64
tests:
  hwtr.ch446q:
    platform_allow:
      - native_sim
      - native_sim/native/64
```

## firmware/common/tests/usbh_hub/testcase.yaml
```yaml
common:
  tags: hwtr
  integration_platforms:
    - native_sim/native/64
tests:
  hwtr.usbh_hub:
    platform_allow:
      - native_sim
      - native_sim/native/64
```

## firmware/dts/bindings/diodes,ap33772s-regulator.yaml
```yaml
# SPDX-License-Identifier: Apache-2.0

description: |
  The USB PD contract of an AP33772S sink, as a regulator: the voltages are
  the source's fixed PDOs (list_voltage), set_voltage requests one (or a
  PPS/AVS voltage inside the range), the current limit is the operating
  current requested, enable/disable drive the output switch.  Callbacks:
  REGULATOR_VOLTAGE_DETECTED when a contract is in place,
  REGULATOR_VOLTAGE_REMOVED when it is lost.

  regulator-min/max-microvolt bound what may ever be requested.

compatible: "diodes,ap33772s-regulator"

include:
  - base.yaml
  - name: regulator.yaml
    property-allowlist:
      - regulator-boot-on
      - regulator-min-microvolt
      - regulator-max-microvolt
      - regulator-max-microamp
```

## firmware/dts/bindings/diodes,ap33772s-sensor.yaml
```yaml
# SPDX-License-Identifier: Apache-2.0

description: |
  Measurements of an AP33772S sink: VOUT (SENSOR_CHAN_VOLTAGE), the current
  through its sense resistor (SENSOR_CHAN_CURRENT) and the NTC temperature
  (SENSOR_CHAN_DIE_TEMP).

compatible: "diodes,ap33772s-sensor"

include: sensor-device.yaml
```

## firmware/dts/bindings/diodes,ap33772s.yaml
```yaml
# SPDX-License-Identifier: Apache-2.0

description: |
  Diodes AP33772S USB PD 3.1 EPR sink controller (I2C), as a multi-function
  device: a "diodes,ap33772s-regulator" child for the contract and a
  "diodes,ap33772s-sensor" child for VBUS, current and temperature.

    ap33772s: ap33772s@52 {
        compatible = "diodes,ap33772s";
        reg = <0x52>;
        int-gpios = <&gpio1 7 GPIO_ACTIVE_HIGH>;

        pd_regulator: regulator {
            compatible = "diodes,ap33772s-regulator";
            regulator-max-microvolt = <28000000>;
        };

        pd_meter: meter {
            compatible = "diodes,ap33772s-sensor";
        };
    };

  The chip runs from VBUS: with zephyr,deferred-init, the application
  initializes it once VBUS is present.

compatible: "diodes,ap33772s"

include: i2c-device.yaml

properties:
  int-gpios:
    type: phandle-array
    description: |
      INT output (active high by default).  Without it the driver polls the
      status register every poll-interval-ms.

  poll-interval-ms:
    type: int
    default: 100
    description: Status polling period without int-gpios.

  epr-delay-ms:
    type: int
    default: 500
    description: |
      The chip enters EPR mode by itself after the first contract, with no
      interrupt: the source capabilities are read again this long after a
      new-PDO event.

  vselmin-microvolt:
    type: int
    description: |
      Lowest contract voltage at which the chip closes its output switch
      (VSELMIN, 200 mV steps), written whenever the chip starts.  Without
      it the chip keeps its default: the VSEL resistor's voltage, or 5 V on
      a part without VSEL (FA01), which closes the switch on the 5 V
      contract every source starts with.

  tr25:
    type: int
    default: 10000
    description: NTC resistance at 25 °C, ohms.

  tr50:
    type: int
    default: 4161
    description: NTC resistance at 50 °C, ohms.

  tr75:
    type: int
    default: 1928
    description: NTC resistance at 75 °C, ohms.

  tr100:
    type: int
    default: 974
    description: NTC resistance at 100 °C, ohms.
```

## firmware/dts/bindings/hwtr,coproc.yaml
```yaml
# SPDX-License-Identifier: Apache-2.0

description: |
  The DATA x4's co-processor (U11, an RP2350B with no flash) on the node's
  USB host: at each power-up it comes up in its ROM's USB bootloader
  (2e8a:000f), and the node loads the image kept in its `coproc` flash
  partition into its SRAM (PICOBOOT), then lets the firmware that starts be
  exported like any device.  Only the device on this hub port is loaded: an
  RP2350 board under test in BOOTSEL is left to USB/IP.

  Example:

    coproc: coproc {
        compatible = "hwtr,coproc";
        hub-port = <5>;
        mark-gpios = <&ports_mx 7 GPIO_ACTIVE_HIGH>;
    };

compatible: "hwtr,coproc"

properties:
  hub-port:
    type: int
    required: true
    description: |
      The downstream port of the hub on the node's root port the
      co-processor is wired to (DATA x4: 5).  0: the device on the root
      port itself, with no hub between.

  mark-gpios:
    type: phandle-array
    description: |
      The node's MARK into the co-processor (DATA x4: the matrix expander's
      P7, U11's GPIO14, the analyzer's CH13): high while the node holds a
      port's RESET or has it off for a power cycle.
```

## firmware/dts/bindings/hwtr,dut-port.yaml
```yaml
# SPDX-License-Identifier: Apache-2.0

description: |
  Power and control lines towards the board under test (DUT) on a
  hw-testing-rack bay node: the TPS2553 current-limited VBUS switch, the
  INA226 that measures it, and the AUX connector (UART + open-drain
  RESET/BOOT lines driven through 2N7002 N-FETs).

  On a DATA x4 board (docs/multi-dut-node.md) there is one node per port,
  its lines on the board's TCA6408A expanders, its INA226 on the board:
  those chips run from DUT_5V, so the firmware talks to them only while
  DUT_5V is on, and sets them up again after each DUT_5V on.

  Example:

    dut_port: dut-port {
        compatible = "hwtr,dut-port";
        enable-gpios = <&gpio0 6 GPIO_ACTIVE_HIGH>;
        fault-gpios = <&gpio0 7 (GPIO_ACTIVE_LOW | GPIO_PULL_UP)>;
        reset-gpios = <&gpio0 11 GPIO_ACTIVE_HIGH>;
        boot-gpios = <&gpio0 12 GPIO_ACTIVE_HIGH>;
        power-monitor = <&ina226>;
        uart = <&uart1>;
    };

compatible: "hwtr,dut-port"

properties:
  enable-gpios:
    type: phandle-array
    required: true
    description: |
      TPS2553 EN.  Active = DUT VBUS on.  The bay node pulls EN up, so the
      DUT is powered before (and without) any firmware: the firmware must
      keep the line in its current state when it configures it.  With
      vin-efuse, the eFuse's SHDN instead, pulled down: off until the
      firmware's checks pass.
      DATA x4: EN is pulled down, every port is off until the firmware
      switches it on, one at a time, within the bay's budget (the
      admission rule); after each DUT_5V on, every port is off again.

  fault-gpios:
    type: phandle-array
    required: true
    description: |
      TPS2553 ~FAULT (open drain, pulled up on the board).  Active while the
      switch is in current limit or thermal shutdown (7.5 ms deglitch).

  reset-gpios:
    type: phandle-array
    description: |
      Gate of the N-FET on the AUX RESET line.  Active = the DUT's RESET
      line is pulled low (DUT held in reset).  Pulled down on the board.
      DATA x4: the line itself, on an expander pin, with a 100k pull-up:
      asserted by configuring the pin as an output low, released by
      configuring it as an input (it then reads 1).

  boot-gpios:
    type: phandle-array
    description: |
      Gate of the N-FET on the AUX BOOT line.  Active = the DUT's BOOT strap
      line is pulled low.  Pulled down on the board.  DATA x4: as
      reset-gpios.

  power-monitor:
    type: phandle
    description: Sensor (INA226) measuring the DUT VBUS voltage and current.

  vin-efuse:
    type: boolean
    description: |
      Node v1.0: enable-gpios drives the SHDN of a TPS26600 eFuse on the
      rack's VIN (20-28 V), out on the DATA lead as DATA_VIN, and
      power-monitor reads DATA_VIN.  SHDN is pulled down: off without
      firmware.  The firmware switches it on only after the checks of the
      DATA lead's power-on rule (docs/firmware.md), and off until the next
      power on after a fault, a DATA board that stops answering or none at
      all.  fault-gpios is the eFuse's ~FLT, also low while it is off or
      ramping.

  bus-gpios:
    type: phandle-array
    description: |
      With vin-efuse: SCL then SDA of the I2C bus out on the DATA lead,
      only read (the pins stay the I2C controller's).  Both must idle high
      before the eFuse goes on: a lead plugged the wrong way round holds
      SCL low.

  uart:
    type: phandle
    description: UART wired to the AUX connector (DUT console).

  sub-slot:
    type: int
    description: |
      DATA board: the port's number, 1-4 on a DATA x4, 1-6 on a DATA x6,
      port 1 leftmost from the DUT side (sub-slot <bay>.<n>,
      config/rack.yaml).

  hub-port:
    type: int
    description: |
      DATA board: the hub's downstream port wired to it; the USB/IP busid
      is 1-1.<hub-port>.  DATA x4: the sub-slot.  DATA x6: 6 for sub-slot
      1, n - 1 for sub-slot n.

  tx-gpios:
    type: phandle-array
    description: |
      The UART's TX pin seen as a GPIO.  The firmware takes the pin from the
      UART to release it (input) while the DUT is powered off, so the node
      does not feed the board through its RX pin, and to hold it low for a
      BREAK; it hands the pin back to the UART afterwards.
```

## firmware/dts/bindings/hwtr,port-pins.yaml
```yaml
# SPDX-License-Identifier: Apache-2.0

description: |
  The DATA x4 v2's port pins on its pin matrix (two CH446Q): one
  mux-controls entry per pin, named p<port>-<pin>.  A pin's state is the
  mask of the buses it joins (the board's devicetree says which bit is
  which bus).

compatible: "hwtr,port-pins"

include: [base.yaml, mux-consumer.yaml]
```
