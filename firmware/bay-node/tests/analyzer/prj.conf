## CMakeLists.txt
```
# SPDX-License-Identifier: Apache-2.0
#
# The logic analyzer relay (src/analyzer.c) on native_sim, against gusmanb's
# analyzer emulated on Zephyr's virtual USB bus (src/cdc_emu.c): ztest.

cmake_minimum_required(VERSION 3.20.0)

set(BAY ${CMAKE_CURRENT_SOURCE_DIR}/../..)
# Same Kconfig options and devicetree bindings as the real application
set(KCONFIG_ROOT ${BAY}/Kconfig)
list(APPEND ZEPHYR_EXTRA_MODULES ${BAY}/../..)

find_package(Zephyr REQUIRED HINTS $ENV{ZEPHYR_BASE})
project(bay_analyzer)

target_include_directories(app PRIVATE ${BAY}/src ${BAY}/../common/include
  ${ZEPHYR_BASE}/subsys/usb/host)
target_sources(app PRIVATE
  src/main.c
  src/cdc_emu.c
  ${BAY}/src/analyzer.c
  ${BAY}/../common/lib/acl.c
)
```

## prj.conf
```kconfig
# The logic analyzer relay on native_sim (see CMakeLists.txt)
# SPDX-License-Identifier: Apache-2.0

CONFIG_ZTEST=y
CONFIG_TEST_RANDOM_GENERATOR=y
CONFIG_LOG=y
CONFIG_BAY_LOG_LEVEL_INF=y

# The host on the virtual bus, with the node's transfers and buffers
CONFIG_USB_HOST_STACK=y
CONFIG_UHC_DRIVER=y
CONFIG_UHC_XFER_COUNT=32
CONFIG_UHC_BUF_COUNT=32
CONFIG_UHC_BUF_POOL_SIZE=4096
# The analyzer on it (src/cdc_emu.c)
CONFIG_USB_DEVICE_STACK_NEXT=y
CONFIG_UDC_BUF_POOL_SIZE=8192
# The virtual bus runs on the system clock (as tests/subsys/usb/host)
CONFIG_SYS_CLOCK_TICKS_PER_SEC=1000000
```

## app.overlay
```dts
/*
 * Zephyr's virtual USB bus (a host controller with a device controller on it,
 * as tests/subsys/usb/host) and the analyzer on its root port, no hub between.
 *
 * SPDX-License-Identifier: Apache-2.0
 */

/delete-node/ &zephyr_udc0;

/ {
	zephyr_uhc0: uhc_vrt0 {
		compatible = "zephyr,uhc-virtual";

		zephyr_udc0: udc_vrt0 {
			compatible = "zephyr,udc-virtual";
			num-bidir-endpoints = <8>;
			maximum-speed = "full-speed";
		};
	};

	coproc: coproc {
		compatible = "hwtr,coproc";
		hub-port = <0>;
	};
};
```

## src/main.c
```c
/*
 * The logic analyzer relay (src/analyzer.c) against gusmanb's analyzer
 * emulated on the virtual USB bus (cdc_emu.c): the bytes both ways, a long
 * stream to a slow page, what happens with no page, one page at a time, the
 * switch to USB/IP and back (a stand-in class takes the device meanwhile) and
 * an analyzer unplugged under a page.
 *
 * SPDX-License-Identifier: Apache-2.0
 */

#include <string.h>

#include <zephyr/kernel.h>
#include <zephyr/usb/usbh.h>
#include <zephyr/ztest.h>

#include <usbh_class.h>

#include "bay.h"
#include "cdc_emu.h"

#define IP1 0x0a000001U
#define IP2 0x0a000002U

USBH_CONTROLLER_DEFINE(test_uhs_ctx, DEVICE_DT_GET(DT_NODELABEL(zephyr_uhc0)));

/* --- USB/IP's stand-in: takes what the analyzer class leaves -------------------- */

static atomic_t usbip_binds;
static atomic_t usbip_removals;

static int usbip_init(struct usbh_class_data *const c_data)
{
	ARG_UNUSED(c_data);

	return 0;
}

static int usbip_probe(struct usbh_class_data *const c_data, struct usb_device *const udev,
		       const uint8_t iface)
{
	ARG_UNUSED(c_data);
	ARG_UNUSED(udev);

	if (iface != USBH_CLASS_IFNUM_DEVICE) {
		return -ENOTSUP;
	}
	atomic_inc(&usbip_binds);

	return 0;
}

static int usbip_removed(struct usbh_class_data *const c_data)
{
	ARG_UNUSED(c_data);
	atomic_inc(&usbip_removals);

	return 0;
}

static struct usbh_class_api usbip_api = {
	.init = usbip_init,
	.probe = usbip_probe,
	.removed = usbip_removed,
};

/* Sorts after "analyzer", as usbip_0... in the node */
USBH_DEFINE_CLASS(usbip_stand_in, &usbip_api, NULL, NULL);

/* --- The DATA board (src/ports.c, not in this test): a DATA x4 unless a test says - */

static enum data_board board = DATA_X4;

enum data_board ports_board(void)
{
	return board;
}

/* --- The page's stand-in ---------------------------------------------------------- */

struct test_page {
	struct analyzer_page page;
	uint8_t got[24576];      /* what the analyzer sent */
	size_t got_len;
	const uint8_t *to_send;  /* what the page sends, handed out once */
	size_t to_send_len;
	int delay_ms;            /* a slow page */
	bool closed;
};

static int page_send(struct analyzer_page *p, const uint8_t *data, size_t len)
{
	struct test_page *t = CONTAINER_OF(p, struct test_page, page);
	size_t n = MIN(len, sizeof(t->got) - t->got_len);

	memcpy(&t->got[t->got_len], data, n);
	t->got_len += n;
	k_msleep(t->delay_ms);

	return len;
}

static int page_recv(struct analyzer_page *p, uint8_t *buf, size_t size)
{
	struct test_page *t = CONTAINER_OF(p, struct test_page, page);
	size_t n = MIN(size, t->to_send_len);

	memcpy(buf, t->to_send, n);
	t->to_send += n;
	t->to_send_len -= n;

	return n;
}

static void page_close(struct analyzer_page *p)
{
	CONTAINER_OF(p, struct test_page, page)->closed = true;
}

static struct test_page pages[3];

static struct test_page *new_page(int i)
{
	pages[i] = (struct test_page){
		.page = {.send = page_send, .recv = page_recv, .close = page_close},
	};

	return &pages[i];
}

/* --- Helpers ------------------------------------------------------------------------ */

#define SOON(cond, ms)                                                                         \
	({                                                                                         \
		int64_t _end = k_uptime_get() + (ms);                                              \
		while (!(cond) && k_uptime_get() < _end) {                                         \
			k_msleep(5);                                                               \
		}                                                                                  \
		(cond);                                                                            \
	})

/* analyzer_json() says this within ms */
static bool json_soon(const char *what, int ms)
{
	static char json[320];

	for (int64_t end = k_uptime_get() + ms; k_uptime_get() <= end; k_msleep(10)) {
		zassert_true(analyzer_json(json, sizeof(json)) > 0);
		if (strstr(json, what) != NULL) {
			return true;
		}
	}
	printk("JSON: %s\n", json);
	return false;
}

/* Plugged in and taken by the relay: DTR and RTS set */
static void plug(uint32_t line_sets)
{
	zassert_ok(cdc_emu_plug());
	zassert_true(SOON(cdc.line_sets == line_sets, 2000), "DTR never set");
	zassert_equal(cdc.line_state, 0x0003, "DTR and RTS");
}

static void *analyzer_setup(void)
{
	zassert_ok(usbh_init(&test_uhs_ctx));
	zassert_ok(usbh_enable(&test_uhs_ctx));
	zassert_ok(cdc_emu_init());

	return NULL;
}

static void analyzer_before(void *fixture)
{
	ARG_UNUSED(fixture);

	/* Whatever the last test left plugged in goes */
	(void)cdc_emu_unplug();
	k_msleep(100);
	cdc_emu_reset();
	zassert_ok(analyzer_set_owner(ANALYZER_PAGE));
	atomic_clear(&usbip_binds);
	atomic_clear(&usbip_removals);
	board = DATA_X4;
}

/* --- Tests ---------------------------------------------------------------------------- */

ZTEST(analyzer, test_1_both_ways)
{
	static const uint8_t id_request[] = {0x55, 0xaa, 0x00, 0xaa, 0x55};
	struct test_page *p = new_page(0);

	zassert_equal(analyzer_attach(&p->page, IP1), -ENODEV, "no analyzer yet");
	plug(1);
	zassert_ok(analyzer_attach(&p->page, IP1));
	zassert_true(json_soon("\"owner\":\"page\",\"present\":true,\"busid\":\"1-1\","
			       "\"page\":{\"ip\":\"10.0.0.1\"", 10));

	/* The page asks who it is; the analyzer's answer comes back whole */
	cdc.answer_id = true;
	p->to_send = id_request;
	p->to_send_len = sizeof(id_request);
	zassert_true(SOON(p->got_len == strlen(cdc_emu_id), 2000), "got %u", p->got_len);
	zassert_mem_equal(p->got, cdc_emu_id, strlen(cdc_emu_id));
	zassert_equal(cdc.got_len, sizeof(id_request));
	zassert_mem_equal(cdc.got, id_request, sizeof(id_request));
	zassert_true(json_soon("\"to_device\":5,", 10));
	zassert_false(p->closed);
}

ZTEST(analyzer, test_2_stream_to_a_slow_page)
{
	static uint8_t capture[20000];
	struct test_page *p = new_page(0);

	for (size_t i = 0; i < sizeof(capture); i++) {
		capture[i] = (uint8_t)(i * 7 + (i >> 8));
	}
	plug(1);
	zassert_ok(analyzer_attach(&p->page, IP1));

	/* 2 ms a chunk: the analyzer waits, nothing is lost or reordered */
	p->delay_ms = 2;
	zassert_ok(cdc_emu_send(capture, sizeof(capture)));
	zassert_true(SOON(p->got_len == sizeof(capture), 5000), "got %u", p->got_len);
	zassert_mem_equal(p->got, capture, sizeof(capture));
	zassert_true(cdc_emu_sent());
	zassert_true(json_soon("\"dropped\":0,", 10));
	zassert_false(p->closed);
}

ZTEST(analyzer, test_3_no_page)
{
	static uint8_t data[3000];

	/* Read and dropped: the analyzer is never left waiting */
	plug(1);
	zassert_ok(cdc_emu_send(data, sizeof(data)));
	zassert_true(SOON(cdc_emu_sent(), 2000));
	zassert_true(json_soon("\"page\":null,", 10));
	zassert_true(json_soon("\"dropped\":3000,", 500));
}

ZTEST(analyzer, test_4_one_page_at_a_time)
{
	struct test_page *a = new_page(0), *b = new_page(1), *c = new_page(2);

	plug(1);
	zassert_ok(analyzer_attach(&a->page, IP1));
	/* Another address waits; the same one is the page reloaded */
	zassert_equal(analyzer_attach(&b->page, IP2), -EBUSY);
	zassert_false(a->closed);
	zassert_ok(analyzer_attach(&c->page, IP1));
	zassert_true(a->closed);
	zassert_false(b->closed);
	zassert_false(c->closed);
}

ZTEST(analyzer, test_5_usbip_and_back)
{
	static const uint8_t data[100] = {1, 2, 3};
	struct test_page *p = new_page(0);

	plug(1);
	zassert_ok(analyzer_attach(&p->page, IP1));
	zassert_equal(atomic_get(&usbip_binds), 0, "the relay has it");

	/* To USB/IP: the page is closed, the other class takes the device */
	zassert_ok(analyzer_set_owner(ANALYZER_USBIP));
	zassert_true(SOON(p->closed, 500));
	zassert_equal(atomic_get(&usbip_binds), 1);
	zassert_equal(analyzer_attach(&new_page(1)->page, IP1), -EACCES);
	zassert_true(json_soon("\"owner\":\"usbip\",\"present\":true,", 10));

	/* The relay no longer reads it */
	zassert_ok(cdc_emu_send(data, sizeof(data)));
	k_msleep(200);
	zassert_false(cdc_emu_sent());

	/* Back to the page: taken from USB/IP, DTR set again, read again */
	zassert_ok(analyzer_set_owner(ANALYZER_PAGE));
	zassert_equal(atomic_get(&usbip_removals), 1);
	zassert_true(SOON(cdc.line_sets == 2, 2000));
	zassert_true(SOON(cdc_emu_sent(), 2000));
	zassert_ok(analyzer_attach(&new_page(2)->page, IP1));
}

ZTEST(analyzer, test_6_unplugged)
{
	struct test_page *p = new_page(0);

	plug(1);
	zassert_ok(analyzer_attach(&p->page, IP1));
	zassert_ok(cdc_emu_unplug());
	zassert_true(SOON(p->closed, 1000));
	zassert_true(json_soon("\"present\":false,", 500));
	zassert_equal(analyzer_attach(&new_page(1)->page, IP1), -ENODEV);

	/* Back: taken again */
	plug(2);
	zassert_ok(analyzer_attach(&new_page(2)->page, IP1));
}

ZTEST(analyzer, test_7_data_x6)
{
	/* On a DATA x6 the co-processor's hub port is its USB-C 6: whatever is there is USB/IP's */
	board = DATA_X6;
	zassert_ok(cdc_emu_plug());
	zassert_true(SOON(atomic_get(&usbip_binds) == 1, 2000), "USB/IP never took it");
	zassert_equal(cdc.line_sets, 0, "the relay set its DTR");
	zassert_equal(analyzer_attach(&new_page(0)->page, IP1), -ENODEV);

	/* The same behind a board the node does not know */
	zassert_ok(cdc_emu_unplug());
	k_msleep(100);
	board = DATA_UNKNOWN;
	zassert_ok(cdc_emu_plug());
	zassert_true(SOON(atomic_get(&usbip_binds) == 2, 2000), "USB/IP never took it");
	zassert_equal(cdc.line_sets, 0, "the relay set its DTR");
}

ZTEST_SUITE(analyzer, NULL, analyzer_setup, analyzer_before, NULL, NULL);
```

## src/cdc_emu.c
```c
/*
 * gusmanb's analyzer on the virtual bus, as far as the relay uses it:
 * 1209:3020 with a CDC control interface (its notification endpoint is never
 * used) and a CDC data interface, a bulk OUT and a bulk IN endpoint.  It
 * keeps what the host writes and the DTR/RTS the host sets, answers the
 * protocol's ID request when told to, and sends what the tests give it a
 * buffer at a time, ending on a zero-length packet as TinyUSB does.
 *
 * SPDX-License-Identifier: Apache-2.0
 */

#include <string.h>

#include <zephyr/drivers/usb/udc.h>
#include <zephyr/kernel.h>
#include <zephyr/sys/byteorder.h>
#include <zephyr/usb/usbd.h>

#include "cdc_emu.h"

#define EMU_MPS	   64
#define EMU_PIECE  512 /* bytes per IN buffer */
#define IN_FLIGHT  2
/* The device stack may renumber the endpoints: their descriptors say where they are */
#define EMU_EP_OUT emu_desc.if1_out_ep.bEndpointAddress
#define EMU_EP_IN  emu_desc.if1_in_ep.bEndpointAddress

#define CDC_SET_CONTROL_LINE_STATE 0x22

/* The analyzer's ID request (cmd 0) and the start of its answer */
static const uint8_t id_request[] = {0x55, 0xaa, 0x00, 0xaa, 0x55};
const char cdc_emu_id[] = "LOGIC_ANALYZER_PICO_2_V6_0\nFREQ:100000000\n";

struct emu_desc {
	struct usb_if_descriptor if0;
	struct usb_ep_descriptor if0_int_ep;
	struct usb_if_descriptor if1;
	struct usb_ep_descriptor if1_out_ep;
	struct usb_ep_descriptor if1_in_ep;
	struct usb_desc_header nil_desc;
};

static struct emu_desc emu_desc = {
	.if0 = {
		.bLength = sizeof(struct usb_if_descriptor),
		.bDescriptorType = USB_DESC_INTERFACE,
		.bInterfaceNumber = 0,
		.bNumEndpoints = 1,
		.bInterfaceClass = USB_BCC_CDC_CONTROL,
		.bInterfaceSubClass = 0x02, /* ACM */
		.bInterfaceProtocol = 0x00,
	},
	.if0_int_ep = {
		.bLength = sizeof(struct usb_ep_descriptor),
		.bDescriptorType = USB_DESC_ENDPOINT,
		.bEndpointAddress = 0x83,
		.bmAttributes = USB_EP_TYPE_INTERRUPT,
		.wMaxPacketSize = sys_cpu_to_le16(16),
		.bInterval = 10,
	},
	.if1 = {
		.bLength = sizeof(struct usb_if_descriptor),
		.bDescriptorType = USB_DESC_INTERFACE,
		.bInterfaceNumber = 1,
		.bNumEndpoints = 2,
		.bInterfaceClass = USB_BCC_CDC_DATA,
	},
	.if1_out_ep = {
		.bLength = sizeof(struct usb_ep_descriptor),
		.bDescriptorType = USB_DESC_ENDPOINT,
		.bEndpointAddress = 0x01,
		.bmAttributes = USB_EP_TYPE_BULK,
		.wMaxPacketSize = sys_cpu_to_le16(EMU_MPS),
	},
	.if1_in_ep = {
		.bLength = sizeof(struct usb_ep_descriptor),
		.bDescriptorType = USB_DESC_ENDPOINT,
		.bEndpointAddress = 0x82,
		.bmAttributes = USB_EP_TYPE_BULK,
		.wMaxPacketSize = sys_cpu_to_le16(EMU_MPS),
	},
};

static const struct usb_desc_header *const emu_fs_desc[] = {
	(struct usb_desc_header *)&emu_desc.if0,
	(struct usb_desc_header *)&emu_desc.if0_int_ep,
	(struct usb_desc_header *)&emu_desc.if1,
	(struct usb_desc_header *)&emu_desc.if1_out_ep,
	(struct usb_desc_header *)&emu_desc.if1_in_ep,
	(struct usb_desc_header *)&emu_desc.nil_desc,
};

struct cdc_emu cdc;

static K_MUTEX_DEFINE(lock);

/* What is being sent to the host */
static struct {
	struct usbd_class_data *c_data;
	const uint8_t *src;
	size_t len;
	size_t off;
	int in_flight;
	bool zlp; /* the zero-length packet that ends a whole number of packets */
} st;

static void arm_out(void)
{
	struct net_buf *buf = usbd_ep_buf_alloc(st.c_data, EMU_EP_OUT, EMU_MPS);

	if (buf != NULL && usbd_ep_enqueue(st.c_data, buf) != 0) {
		net_buf_unref(buf);
	}
}

/* Under lock: the next buffers of what is being sent */
static void feed(void)
{
	while (st.c_data != NULL && st.in_flight < IN_FLIGHT && (st.off < st.len || st.zlp)) {
		size_t n = MIN(EMU_PIECE, st.len - st.off);
		struct net_buf *buf = usbd_ep_buf_alloc(st.c_data, EMU_EP_IN, MAX(n, EMU_MPS));

		if (buf == NULL) {
			return;
		}
		net_buf_add_mem(buf, st.src + st.off, n);
		if (usbd_ep_enqueue(st.c_data, buf) != 0) {
			net_buf_unref(buf);
			return;
		}
		st.in_flight++;
		st.off += n;
		if (n == 0) {
			st.zlp = false;
		} else if (st.off == st.len) {
			st.zlp = st.len % EMU_MPS == 0;
		}
	}
}

int cdc_emu_send(const uint8_t *data, size_t len)
{
	int ret = 0;

	k_mutex_lock(&lock, K_FOREVER);
	if (st.off < st.len || st.in_flight > 0) {
		ret = -EBUSY;
	} else {
		st.src = data;
		st.len = len;
		st.off = 0;
		st.zlp = false;
		feed();
	}
	k_mutex_unlock(&lock);

	return ret;
}

bool cdc_emu_sent(void)
{
	bool sent;

	k_mutex_lock(&lock, K_FOREVER);
	sent = st.off == st.len && !st.zlp && st.in_flight == 0;
	k_mutex_unlock(&lock);

	return sent;
}

static int emu_request(struct usbd_class_data *const c_data, struct net_buf *const buf,
		       const int err)
{
	struct udc_buf_info *const bi = udc_get_buf_info(buf);

	ARG_UNUSED(c_data);

	k_mutex_lock(&lock, K_FOREVER);
	if (bi->ep == EMU_EP_IN) {
		st.in_flight--;
		if (err == 0) {
			feed();
		}
	} else if (bi->ep == EMU_EP_OUT && err == 0) {
		size_t n = MIN(buf->len, sizeof(cdc.got) - cdc.got_len);

		memcpy(&cdc.got[cdc.got_len], buf->data, n);
		cdc.got_len += n;
		if (cdc.answer_id && cdc.got_len >= sizeof(id_request) &&
		    memcmp(&cdc.got[cdc.got_len - sizeof(id_request)], id_request,
			   sizeof(id_request)) == 0 &&
		    st.off == st.len && st.in_flight == 0) {
			st.src = (const uint8_t *)cdc_emu_id;
			st.len = strlen(cdc_emu_id);
			st.off = 0;
			feed();
		}
		arm_out();
	}
	k_mutex_unlock(&lock);
	net_buf_unref(buf);

	return 0;
}

static int emu_control_to_dev(struct usbd_class_data *const c_data,
			      const struct usb_setup_packet *const setup,
			      const struct net_buf *const buf)
{
	ARG_UNUSED(c_data);
	ARG_UNUSED(buf);

	if (setup->bRequest != CDC_SET_CONTROL_LINE_STATE) {
		errno = -ENOTSUP;
		return 0;
	}
	cdc.line_state = sys_le16_to_cpu(setup->wValue);
	cdc.line_sets++;

	return 0;
}

static const void *emu_get_desc(struct usbd_class_data *const c_data, const enum usbd_speed speed)
{
	ARG_UNUSED(c_data);
	ARG_UNUSED(speed);

	return emu_fs_desc;
}

static void emu_enable(struct usbd_class_data *const c_data)
{
	k_mutex_lock(&lock, K_FOREVER);
	st.c_data = c_data;
	st.in_flight = 0;
	arm_out();
	feed();
	k_mutex_unlock(&lock);
}

static void emu_disable(struct usbd_class_data *const c_data)
{
	ARG_UNUSED(c_data);
}

static int emu_init(struct usbd_class_data *const c_data)
{
	ARG_UNUSED(c_data);

	return 0;
}

static const struct usbd_class_api emu_api = {
	.request = emu_request,
	.control_to_dev = emu_control_to_dev,
	.get_desc = emu_get_desc,
	.enable = emu_enable,
	.disable = emu_disable,
	.init = emu_init,
};

USBD_DEFINE_CLASS(cdc_emu, &emu_api, NULL, NULL);

USBD_DEVICE_DEFINE(emu_usbd, DEVICE_DT_GET(DT_NODELABEL(zephyr_udc0)), 0x1209, 0x3020);
USBD_DESC_LANG_DEFINE(emu_lang);
USBD_DESC_CONFIG_DEFINE(emu_cfg_desc, "FS Configuration");
USBD_CONFIGURATION_DEFINE(emu_config, 0, 50, &emu_cfg_desc);

int cdc_emu_init(void)
{
	int ret;

	ret = usbd_add_descriptor(&emu_usbd, &emu_lang);
	if (ret == 0) {
		ret = usbd_add_configuration(&emu_usbd, USBD_SPEED_FS, &emu_config);
	}
	if (ret == 0) {
		ret = usbd_register_class(&emu_usbd, "cdc_emu", USBD_SPEED_FS, 1);
	}
	if (ret == 0) {
		ret = usbd_init(&emu_usbd);
	}

	return ret;
}

void cdc_emu_reset(void)
{
	k_mutex_lock(&lock, K_FOREVER);
	memset(&cdc, 0, sizeof(cdc));
	st.src = NULL;
	st.len = 0;
	st.off = 0;
	st.zlp = false;
	st.in_flight = 0;
	k_mutex_unlock(&lock);
}

int cdc_emu_plug(void)
{
	return usbd_enable(&emu_usbd);
}

int cdc_emu_unplug(void)
{
	k_mutex_lock(&lock, K_FOREVER);
	st.c_data = NULL;
	k_mutex_unlock(&lock);

	return usbd_disable(&emu_usbd);
}
```

## src/cdc_emu.h
```c
/*
 * gusmanb's analyzer on the virtual bus (cdc_emu.c), for the tests
 *
 * SPDX-License-Identifier: Apache-2.0
 */

#ifndef CDC_EMU_H_
#define CDC_EMU_H_

#include <stdbool.h>
#include <stddef.h>
#include <stdint.h>

struct cdc_emu {
	uint8_t got[1024];   /* what the host wrote */
	size_t got_len;
	uint16_t line_state; /* the last SET_CONTROL_LINE_STATE: DTR bit 0, RTS bit 1 */
	uint32_t line_sets;
	bool answer_id;      /* answer the ID request with cdc_emu_id */
};

extern struct cdc_emu cdc;
extern const char cdc_emu_id[];

int cdc_emu_init(void);
void cdc_emu_reset(void);
int cdc_emu_plug(void);
int cdc_emu_unplug(void);
/* Sends data to the host as it reads it (data must stay valid); -EBUSY while sending */
int cdc_emu_send(const uint8_t *data, size_t len);
/* Everything given to cdc_emu_send() went to the host */
bool cdc_emu_sent(void);

#endif /* CDC_EMU_H_ */
```
